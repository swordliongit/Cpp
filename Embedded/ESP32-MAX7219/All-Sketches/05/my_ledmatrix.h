//https://majicdesigns.github.io/MD_Parola/class_m_d___parola.html
#include <MD_Parola.h>
#include <MD_MAX72xx.h>
#include <SPI.h>
#include <String>

#define HARDWARE_TYPE MD_MAX72XX::FC16_HW
#define MAX_DEVICES 8
#define CS_PIN 15
#define DIN 23
#define CLK 18

MD_Parola myDisplay = MD_Parola(HARDWARE_TYPE, CS_PIN, MAX_DEVICES);

// Pause time
const uint16_t PAUSE_TIME = 1000; // in milliseconds

// Sprite Definitions
const uint8_t F_PMAN1 = 6;
const uint8_t W_PMAN1 = 8;
const uint8_t PROGMEM pacman1[F_PMAN1 * W_PMAN1] =  // gobbling pacman animation
{
  0x00, 0x81, 0xc3, 0xe7, 0xff, 0x7e, 0x7e, 0x3c,
  0x00, 0x42, 0xe7, 0xe7, 0xff, 0xff, 0x7e, 0x3c,
  0x24, 0x66, 0xe7, 0xff, 0xff, 0xff, 0x7e, 0x3c,
  0x3c, 0x7e, 0xff, 0xff, 0xff, 0xff, 0x7e, 0x3c,
  0x24, 0x66, 0xe7, 0xff, 0xff, 0xff, 0x7e, 0x3c,
  0x00, 0x42, 0xe7, 0xe7, 0xff, 0xff, 0x7e, 0x3c,
};

const uint8_t F_PMAN2 = 6;
const uint8_t W_PMAN2 = 18;
const uint8_t PROGMEM pacman2[F_PMAN2 * W_PMAN2] =  // ghost pursued by a pacman
{
  0x00, 0x81, 0xc3, 0xe7, 0xff, 0x7e, 0x7e, 0x3c, 0x00, 0x00, 0x00, 0xfe, 0x7b, 0xf3, 0x7f, 0xfb, 0x73, 0xfe,
  0x00, 0x42, 0xe7, 0xe7, 0xff, 0xff, 0x7e, 0x3c, 0x00, 0x00, 0x00, 0xfe, 0x7b, 0xf3, 0x7f, 0xfb, 0x73, 0xfe,
  0x24, 0x66, 0xe7, 0xff, 0xff, 0xff, 0x7e, 0x3c, 0x00, 0x00, 0x00, 0xfe, 0x7b, 0xf3, 0x7f, 0xfb, 0x73, 0xfe,
  0x3c, 0x7e, 0xff, 0xff, 0xff, 0xff, 0x7e, 0x3c, 0x00, 0x00, 0x00, 0xfe, 0x7b, 0xf3, 0x7f, 0xfb, 0x73, 0xfe,
  0x24, 0x66, 0xe7, 0xff, 0xff, 0xff, 0x7e, 0x3c, 0x00, 0x00, 0x00, 0xfe, 0x7b, 0xf3, 0x7f, 0xfb, 0x73, 0xfe,
  0x00, 0x42, 0xe7, 0xe7, 0xff, 0xff, 0x7e, 0x3c, 0x00, 0x00, 0x00, 0xfe, 0x7b, 0xf3, 0x7f, 0xfb, 0x73, 0xfe,
};

const uint8_t F_ROCKET = 2;
const uint8_t W_ROCKET = 11;
const uint8_t PROGMEM rocket[F_ROCKET * W_ROCKET] =  // rocket
{
  0x18, 0x24, 0x42, 0x81, 0x99, 0x18, 0x99, 0x18, 0xa5, 0x5a, 0x81,
  0x18, 0x24, 0x42, 0x81, 0x18, 0x99, 0x18, 0x99, 0x24, 0x42, 0x99,
};

const uint8_t F_BUNNY = 1;
const uint8_t W_BUNNY = 8;
static const uint8_t PROGMEM bunny[F_BUNNY * W_BUNNY] =
{
  0x66, 0x66, 0x66, 0xff, 0x81, 0xa5, 0x99, 0x7e
};

const uint8_t F_WALKER = 5;
const uint8_t W_WALKER = 7;
const uint8_t PROGMEM walker[F_WALKER * W_WALKER] =  // walking man
{
  0x00, 0x48, 0x77, 0x1f, 0x1c, 0x94, 0x68,
  0x00, 0x90, 0xee, 0x3e, 0x38, 0x28, 0xd0,
  0x00, 0x00, 0xae, 0xfe, 0x38, 0x28, 0x40,
  0x00, 0x00, 0x2e, 0xbe, 0xf8, 0x00, 0x00,
  0x00, 0x10, 0x6e, 0x3e, 0xb8, 0xe8, 0x00,
};

const uint8_t F_HEART = 5;
const uint8_t W_HEART = 9;
const uint8_t PROGMEM heart[F_HEART * W_HEART] =  // beating heart
{
  0x0e, 0x11, 0x21, 0x42, 0x84, 0x42, 0x21, 0x11, 0x0e,
  0x0e, 0x1f, 0x33, 0x66, 0xcc, 0x66, 0x33, 0x1f, 0x0e,
  0x0e, 0x1f, 0x3f, 0x7e, 0xfc, 0x7e, 0x3f, 0x1f, 0x0e,
  0x0e, 0x1f, 0x33, 0x66, 0xcc, 0x66, 0x33, 0x1f, 0x0e,
  0x0e, 0x11, 0x21, 0x42, 0x84, 0x42, 0x21, 0x11, 0x0e,
};

const uint8_t F_GHOST = 2;
const uint8_t W_GHOST = 7;
static const uint8_t PROGMEM ghost[F_GHOST * W_GHOST] =
{
  0xfe, 0x7b, 0xf3, 0x7f, 0xfb, 0x73, 0xfe,
  0xfe, 0x73, 0xfb, 0x7f, 0xf3, 0x7b, 0xfe,
};

const uint8_t F_WAVE = 14;
const uint8_t W_WAVE = 14;
const uint8_t PROGMEM wave[F_WAVE * W_WAVE] =  // triangular wave / worm
{
  0x08, 0x04, 0x02, 0x01, 0x02, 0x04, 0x08, 0x10, 0x20, 0x40, 0x80, 0x40, 0x20, 0x10,
  0x10, 0x08, 0x04, 0x02, 0x01, 0x02, 0x04, 0x08, 0x10, 0x20, 0x40, 0x80, 0x40, 0x20,
  0x20, 0x10, 0x08, 0x04, 0x02, 0x01, 0x02, 0x04, 0x08, 0x10, 0x20, 0x40, 0x80, 0x40,
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  0x04, 0x02, 0x01, 0x02, 0x04, 0x08, 0x10, 0x20, 0x40, 0x80, 0x40, 0x20, 0x10, 0x08,
};


void startDisplay() {
  // Intialize the object:
  myDisplay.begin();
  // Set the intensity (brightness) of the display (0-15):
  myDisplay.setIntensity(5);
  myDisplay.setInvert(false);
  // Clear the display:
  myDisplay.displayClear();
  //displayText(pText, align, speed, pause, effectIn, effectOut (150 langsam 100 schnller)
  myDisplay.displayText("Loading...", PA_CENTER, 150, 2000, PA_SCROLL_LEFT, PA_SCROLL_RIGHT);
}

void changeDisplay(String whichsprite) {
  myDisplay.displayClear();
  Serial.println(whichsprite);

  if (whichsprite == "rocket") {
    myDisplay.setSpriteData(rocket, W_ROCKET, F_ROCKET, rocket, W_ROCKET, F_ROCKET);
    myDisplay.displayText("ARDUINO", PA_CENTER, 100, PAUSE_TIME, PA_SPRITE, PA_SPRITE);
  }
  else if (whichsprite == "bunny") {
    myDisplay.setSpriteData(bunny, W_BUNNY, F_BUNNY, bunny, W_BUNNY, F_BUNNY);
    myDisplay.displayText("ARDUINO", PA_CENTER, 100, PAUSE_TIME, PA_SPRITE, PA_SPRITE);
  }
  else if (whichsprite == "ghost") {
    myDisplay.setSpriteData(ghost, W_GHOST, F_GHOST, ghost, W_GHOST, F_GHOST);
    myDisplay.displayText("ARDUINO", PA_CENTER, 100, PAUSE_TIME, PA_SPRITE, PA_SPRITE);
  }
  else if (whichsprite == "pacman") {
    myDisplay.displayText("ARDUINO", PA_CENTER, 100, PAUSE_TIME, PA_SPRITE, PA_SPRITE);
    myDisplay.setSpriteData(pacman1, W_PMAN1, F_PMAN1, pacman1, W_PMAN1, F_PMAN1);
  }
  else if (whichsprite == "walker") {
    myDisplay.displayText("ARDUINO", PA_CENTER, 100, PAUSE_TIME, PA_SPRITE, PA_SPRITE);
    myDisplay.setSpriteData(walker, W_WALKER, F_WALKER, walker, W_WALKER, F_WALKER);
  }
  else if (whichsprite == "wave") {
    myDisplay.displayText("ARDUINO", PA_CENTER, 100, PAUSE_TIME, PA_SPRITE, PA_SPRITE);
    myDisplay.setSpriteData(wave, W_WAVE, F_WAVE , wave, W_WAVE, F_WAVE );
  }
  else if (whichsprite == "heart") {
    myDisplay.displayText("ARDUINO", PA_CENTER, 100, PAUSE_TIME, PA_SPRITE, PA_SPRITE);
    myDisplay.setSpriteData(heart, W_HEART, F_HEART  , heart, W_HEART, F_HEART  );
  }
}
